AUTOSAR XML (schema 4-3-1)
standard types defined: UInt16, Float, uint16, float32
package /TPC_Composition/DataTypes
  impl type MyStruct: category=STRUCTURE
    element BP1: implementation-data-type=rt_Array_Float_11
    element Table: implementation-data-type=rt_Array_Float_11
  impl type rt_Array_Float_11: category=ARRAY
    element rt_Array_Float_11: array-size=11, array-size-semantics=FIXED-SIZE, implementation-data-type=Float
package /TPC_Composition/DataTypes/ApplDataTypes
  app type Appl_SetpointPercent_LkupTbl: category=CURVE, sw-calibration-access=READ-WRITE, sw-calprm-axis-set={sw-axis-index=1, category=STD_AXIS, sw-axis-individual={input-variable-type=Float, compu {identical}, sw-max-axis-points=11, sw-min-axis-points=11, range phys -INF..INF}}, compu {identical}, range phys -INF..INF, sw-record-layout=IntCur_f32_f32_M, value-axis-data-type=Float
  app type Float: category=VALUE, sw-calibration-access=READ-WRITE, compu {identical}, range phys -INF..INF
package /TPC_Composition/DataTypes/Constants
  constant specification SetpointPercent_LkupTbl: value-spec=[0 10 20 30 40 50 60 70 80 90 100] over axis [170 251.5 333 414.5 496 577.5 659 740.5 822 903.5 985]
package /TPC_Composition/DataTypes/DataTypeMappings
  data type mapping set PedalSensorDataTypeMappingsSet
    data-type-maps:
      application-data-type=Appl_SetpointPercent_LkupTbl, implementation-data-type=MyStruct
      application-data-type=Float, implementation-data-type=Float
package /TPC_Composition/DataTypes/SwAddrMethods
  sw addr method CODE: section-type=CODE
  sw addr method CONST: section-type=CONST
  sw addr method VAR: section-type=VAR
package /TPC_Composition/DataTypes/SwRecordLayouts
  sw record layout IntCur_f32_f32
  sw record layout IntCur_f32_f32_M: sw-record-layout-group={short-label=IntCur_f32_f32_M, sw-record-layout-group={short-label=X, category=INDEX_INCR, sw-record-layout-group-axis=1, sw-record-layout-group-index=X, sw-record-layout-group-from=1, sw-record-layout-group-to=-1, sw-record-layout-v={short-label=VALUE, base-type=float32, sw-record-layout-v-axis=1, sw-record-layout-v-prop=VALUE}}, sw-record-layout-group={short-label=Val, category=COLUMN_DIR, sw-record-layout-group-axis=1, sw-record-layout-group-index=X, sw-record-layout-group-from=1, sw-record-layout-group-to=-1, sw-record-layout-v={short-label=Val, base-type=float32, sw-record-layout-v-axis=0, sw-record-layout-v-prop=VALUE, sw-record-layout-v-index=X}}}
package /TPC_Composition/DataTypes/Units
  unit NoUnit: factor-si-to-unit=1, offset-si-to-unit=0
