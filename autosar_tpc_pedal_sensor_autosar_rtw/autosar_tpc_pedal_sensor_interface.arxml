AUTOSAR XML (schema 4-3-1)
package /Interfaces
  sender receiver interface APP_HwIO
    data Value: category=VALUE, sw-calibration-access=READ-ONLY, type=UInt16
  sender receiver interface APP_Percent
    data Value: category=VALUE, sw-calibration-access=READ-ONLY, type=Float
