AUTOSAR XML (schema 4-3-1)
package /TPC_Composition/Interfaces
  4 x sender receiver interface:
    TPS_Primary
      data Value: category=VALUE, sw-calibration-access=READ-ONLY, type=float32
    TPS_Seconday
      data Value: category=VALUE, sw-calibration-access=READ-ONLY, type=float32
    TPS_Percent
      data Value: category=VALUE, sw-calibration-access=READ-ONLY, type=float32
    TPS_Secondary
      data Value: category=VALUE, sw-calibration-access=READ-ONLY, type=float32
