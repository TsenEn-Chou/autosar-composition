AUTOSAR XML (schema 4-3-1)
package /Components/SwcImplementations
  swc implementation PedalSensor_Impl: programming-language=C, sw-version=5.2.1, used-code-generator=Embedded Coder 7.8 (R2022a) 23-Nov-2021, vendor-id=0, behavior=PedalSensor_IB
    code-descriptors:
      code Code
        artifact-descriptors:
          short-label=autosar_tpc_pedal_sensor_c, category=SWSRC
          short-label=autosar_tpc_pedal_sensor_h, category=SWHDR
          short-label=autosar_tpc_pedal_sensor_private_h, category=SWHDR
          short-label=autosar_tpc_pedal_sensor_types_h, category=SWHDR
          short-label=rtwtypes_h, category=SWHDR
    resource consumption RsrcCons_autosar_tpc_pedal_sensor
