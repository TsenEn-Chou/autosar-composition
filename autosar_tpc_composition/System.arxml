AUTOSAR XML (schema 4-3-1)
package /System
  system EcuExtract: category=ECU_EXTRACT
    system mapping SystemMapping
      sw-mappings:
        swc to ecu mapping SwcToEcuMapping: component=[Ctrl, Actuator, Ctrl2, TPS_Primary, TPS_Secondary, Monitor, PedalSensor], ecu-instance=EcuInstance
    root-software-compositions:
      root sw composition prototype RootSwCompositionPrototype: software-composition=TPC_Composition
  ecu instance EcuInstance
