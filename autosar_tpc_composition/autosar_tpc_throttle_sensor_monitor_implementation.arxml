AUTOSAR XML (schema 4-3-1)
package /Components/SwcImplementations
  swc implementation ThrottleSensorMonitor_Impl: programming-language=C, sw-version=5.1.1, used-code-generator=Embedded Coder 7.9 (R2022b) 13-May-2022, vendor-id=0, behavior=ThrottleSensorMonitor_IB
    code-descriptors:
      code Code
        artifact-descriptors:
          short-label=autosar_tpc_throttle_sensor_monitor_c, category=SWSRC
          short-label=autosar_tpc_throttle_sensor_monitor_h, category=SWHDR
          short-label=autosar_tpc_throttle_sensor_monitor_private_h, category=SWHDR
          short-label=autosar_tpc_throttle_sensor_monitor_types_h, category=SWHDR
          short-label=rtwtypes_h, category=SWHDR
    resource consumption RsrcCons_autosar_tpc_throttle_sensor_monitor
