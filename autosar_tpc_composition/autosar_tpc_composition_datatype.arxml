AUTOSAR XML (schema 4-3-1)
standard types defined: Float, SInt16, UInt8, Double, UInt32, UInt16, float32, sint16, sint32, float64, uint8, uint32, uint16
package /DataTypes
  9 x impl type:
    MyStruct_Actuator: category=STRUCTURE
      element BP1: implementation-data-type=rt_Array_Float_21
      element Table: implementation-data-type=rt_Array_SInt16_21
    rt_Array_Float_21: category=ARRAY
      element rt_Array_Float_21: array-size=21, array-size-semantics=FIXED-SIZE, implementation-data-type=Float
    rt_Array_SInt16_21: category=ARRAY
      element rt_Array_SInt16_21: array-size=21, array-size-semantics=FIXED-SIZE, implementation-data-type=SInt16
    MyStruct: category=STRUCTURE
      5 x element, all with category=TYPE_REFERENCE:
        N2: implementation-data-type=UInt32
        N1: implementation-data-type=UInt32
        BP2: implementation-data-type=rt_Array_Float_4
        BP1: implementation-data-type=rt_Array_float32_11
        Table: implementation-data-type=rt_Array_float32_11
    rt_Array_Float_4: category=ARRAY
      element rt_Array_Float_4: array-size=4, array-size-semantics=FIXED-SIZE, implementation-data-type=Float
    rt_Array_Float_3: category=ARRAY
      element rt_Array_Float_3: array-size=3, array-size-semantics=FIXED-SIZE, implementation-data-type=Float
    rt_Array_Double_12: category=ARRAY
      element rt_Array_Double_12: array-size=12, array-size-semantics=FIXED-SIZE, implementation-data-type=Double
    rt_Array_Float_11: category=ARRAY
      element rt_Array_Float_11: array-size=11, array-size-semantics=FIXED-SIZE, implementation-data-type=Float
    rt_Array_float32_11: category=ARRAY
      element rt_Array_float32_11: array-size=11, array-size-semantics=FIXED-SIZE, implementation-data-type=float32
package /DataTypes/ApplDataTypes
  8 x app type, all with sw-calibration-access=READ-WRITE, compu {identical}:
    Appl_HBridgeCmd_LkupTbl: category=CURVE, sw-calprm-axis-set={sw-axis-index=1, category=STD_AXIS, sw-axis-individual={input-variable-type=Float, compu {identical}, sw-max-axis-points=21, sw-min-axis-points=21, range phys -INF..INF}}, range phys -32768..32767, sw-record-layout=IntCur_f32_s16, value-axis-data-type=SInt16
    SInt16: category=VALUE, range phys -32768..32767
    Float: category=VALUE, range phys -INF..INF
    Appl_my2d_LkupTbl:
      category=MAP
      sw-calprm-axis-set=[{sw-axis-index=1, category=STD_AXIS, sw-axis-individual={input-variable-type=Float, compu {identical}, sw-max-axis-points=4, sw-min-axis-points=4, range phys -INF..INF}}, {sw-axis-index=2, category=STD_AXIS, sw-axis-individual={input-variable-type=Float, compu {identical}, sw-max-axis-points=3, sw-min-axis-points=3, range phys -INF..INF}}]
      range phys -INF..INF
      sw-record-layout=IntMap_f32f32_f64
      value-axis-data-type=Double
    Double: category=VALUE, range phys -INF..INF
    Appl_SetpointPercent_LkupTbl: category=CURVE, sw-calprm-axis-set={sw-axis-index=1, category=STD_AXIS, sw-axis-individual={input-variable-type=Float, compu {identical}, sw-max-axis-points=11, sw-min-axis-points=11, range phys -INF..INF}}, range phys -INF..INF, sw-record-layout=IntCur_f32_f32, value-axis-data-type=Float
    Appl_TPSPrimaryPercent_LkupTbl: category=CURVE, sw-calprm-axis-set={sw-axis-index=1, category=STD_AXIS, sw-axis-individual={input-variable-type=Float, compu {identical}, sw-max-axis-points=11, sw-min-axis-points=11, data-constr=dc_25047333}}, data-constr=dc_25047333, sw-record-layout=IntCur_f32_f32, value-axis-data-type=Float
    Appl_TPSSecondaryPercent_LkupTbl: category=CURVE, sw-calprm-axis-set={sw-axis-index=1, category=STD_AXIS, sw-axis-individual={input-variable-type=Float, compu {identical}, sw-max-axis-points=11, sw-min-axis-points=11, data-constr=dc_25047333}}, data-constr=dc_25047333, sw-record-layout=IntCur_f32_f32, value-axis-data-type=Float
package /DataTypes/Constants
  5 x constant specification:
    HBridgeCmd_LkupTbl: value-spec=[-2048 -1843 -1638 -1434 -1229 -1024 -819 -614 -410 -205 0 205 410 614 819 1024 1229 1434 1638 1843 2048] over axis [-100 -90 -80 -70 -60 -50 -40 -30 -20 -10 0 10 20 30 40 50 60 70 80 90 100]
    my2d_LkupTbl: value-spec=[2 3 4 3 4 5 4 5 6 5 6 7] over axis [1 2 3 4] over axis [1 2 3]
    SetpointPercent_LkupTbl: value-spec=[0 10 20 30 40 50 60 70 80 90 100] over axis [170 251.5 333 414.5 496 577.5 659 740.5 822 903.5 985]
    TPSPrimaryPercent_LkupTbl: value-spec=[0 10 20 30 40 50 60 70 80 90 100] over axis [170 249.60000610351562 329.20001220703125 408.79998779296875 488.3999938964844 568 647.5999755859375 727.2000122070312 806.7999877929688 886.4000244140625 966]
    TPSSecondaryPercent_LkupTbl: value-spec=[100 90 80 70 60 50 40 30 20 10 0] over axis [170 249.60000610351562 329.20001220703125 408.79998779296875 488.3999938964844 568 647.5999755859375 727.2000122070312 806.7999877929688 886.4000244140625 966]
package /DataTypes/DataTypeMappings
  5 x data type mapping set:
    ActuatorDataTypeMappingsSet
      data-type-maps:
        application-data-type=Appl_HBridgeCmd_LkupTbl, implementation-data-type=MyStruct_Actuator
        application-data-type=SInt16, implementation-data-type=SInt16
        application-data-type=Float, implementation-data-type=Float
    ctrl2DataTypeMappingsSet
      data-type-maps:
        application-data-type=Double, implementation-data-type=Double
        application-data-type=Float, implementation-data-type=Float
        application-data-type=Appl_my2d_LkupTbl, implementation-data-type=MyStruct
    PedalSensorDataTypeMappingsSet
      data-type-maps:
        application-data-type=Appl_SetpointPercent_LkupTbl, implementation-data-type=MyStruct
        application-data-type=Float, implementation-data-type=Float
    ThrottleSensor1DataTypeMappingsSet
      data-type-maps:
        application-data-type=Appl_TPSPrimaryPercent_LkupTbl, implementation-data-type=MyStruct
        application-data-type=Float, implementation-data-type=float32
    ThrottleSensor2DataTypeMappingsSet
      data-type-maps:
        application-data-type=Appl_TPSSecondaryPercent_LkupTbl, implementation-data-type=MyStruct
        application-data-type=Float, implementation-data-type=float32
package /DataTypes/SwAddrMethods
  sw addr method CODE: section-type=CODE
  sw addr method CONST: section-type=CONST
  sw addr method VAR: section-type=VAR
package /DataTypes/SwRecordLayouts
  sw record layout IntCur_f32_s16: sw-record-layout-group={short-label=IntCur_f32_s16, sw-record-layout-group={short-label=X, category=INDEX_INCR, sw-record-layout-group-axis=1, sw-record-layout-group-index=X, sw-record-layout-group-from=1, sw-record-layout-group-to=-1, sw-record-layout-v={short-label=VALUE, base-type=float64, sw-record-layout-v-axis=1, sw-record-layout-v-prop=VALUE}}, sw-record-layout-group={short-label=Val, category=COLUMN_DIR, sw-record-layout-group-axis=1, sw-record-layout-group-index=X, sw-record-layout-group-from=1, sw-record-layout-group-to=-1, sw-record-layout-v={short-label=Val, base-type=sint32, sw-record-layout-v-axis=0, sw-record-layout-v-prop=VALUE, sw-record-layout-v-index=X}}}
  sw record layout IntMap_f32f32_f64: sw-record-layout-group={short-label=IntMap_f32f32_f64, sw-record-layout-v={short-label=Nx, base-type=uint32, sw-record-layout-v-axis=1, sw-record-layout-v-prop=COUNT}, sw-record-layout-v={short-label=Ny, base-type=uint32, sw-record-layout-v-axis=2, sw-record-layout-v-prop=COUNT}, sw-record-layout-group={short-label=X, category=INDEX_INCR, sw-record-layout-group-axis=1, sw-record-layout-group-index=X, sw-record-layout-group-from=1, sw-record-layout-group-to=-1, sw-record-layout-v={short-label=VALUE, base-type=float64, sw-record-layout-v-axis=1, sw-record-layout-v-prop=VALUE}}, sw-record-layout-group={short-label=Y, category=INDEX_INCR, sw-record-layout-group-axis=2, sw-record-layout-group-index=Y, sw-record-layout-group-from=1, sw-record-layout-group-to=-1, sw-record-layout-v={short-label=VALUE, base-type=float64, sw-record-layout-v-axis=2, sw-record-layout-v-prop=VALUE}}, sw-record-layout-group={short-label=Val, category=COLUMN_DIR, sw-record-layout-group-axis=1, sw-record-layout-group-index=X, sw-record-layout-group-from=1, sw-record-layout-group-to=-1, sw-record-layout-group={short-label=Val, sw-record-layout-group-axis=2, sw-record-layout-group-index=Y, sw-record-layout-group-from=1, sw-record-layout-group-to=-1, sw-record-layout-v={short-label=Val, base-type=float64, sw-record-layout-v-axis=0, sw-record-layout-v-prop=VALUE, sw-record-layout-v-index=X Y}}}}
  sw record layout IntCur_f32_f32: sw-record-layout-group={short-label=IntCur_f32_f32, sw-record-layout-v={short-label=Nx, base-type=uint32, sw-record-layout-v-axis=1, sw-record-layout-v-prop=COUNT}, sw-record-layout-v={short-label=Nx, base-type=uint32, sw-record-layout-v-axis=1, sw-record-layout-v-prop=COUNT}, sw-record-layout-group={short-label=X, category=INDEX_INCR, sw-record-layout-group-axis=1, sw-record-layout-group-index=X, sw-record-layout-group-from=1, sw-record-layout-group-to=-1, sw-record-layout-v={short-label=VALUE, base-type=float64, sw-record-layout-v-axis=1, sw-record-layout-v-prop=VALUE}}, sw-record-layout-group={short-label=Val, category=COLUMN_DIR, sw-record-layout-group-axis=1, sw-record-layout-group-index=X, sw-record-layout-group-from=1, sw-record-layout-group-to=-1, sw-record-layout-v={short-label=Val, base-type=float64, sw-record-layout-v-axis=0, sw-record-layout-v-prop=VALUE, sw-record-layout-v-index=X}}, sw-record-layout-group={short-label=X, category=INDEX_INCR, sw-record-layout-group-axis=1, sw-record-layout-group-index=X, sw-record-layout-group-from=1, sw-record-layout-group-to=-1, sw-record-layout-v={short-label=VALUE, base-type=float64, sw-record-layout-v-axis=1, sw-record-layout-v-prop=VALUE}}, sw-record-layout-group={short-label=Val, category=COLUMN_DIR, sw-record-layout-group-axis=1, sw-record-layout-group-index=X, sw-record-layout-group-from=1, sw-record-layout-group-to=-1, sw-record-layout-v={short-label=Val, base-type=float64, sw-record-layout-v-axis=0, sw-record-layout-v-prop=VALUE, sw-record-layout-v-index=X}}}
package /DataTypes/Units
  unit NoUnit: factor-si-to-unit=1, offset-si-to-unit=0
