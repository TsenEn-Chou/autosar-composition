AUTOSAR XML (schema 4-3-1)
package /Components/SwcImplementations
  swc implementation Actuator_Impl: programming-language=C, sw-version=5.0.1, used-code-generator=Embedded Coder 7.8 (R2022a) 23-Nov-2021, vendor-id=0, behavior=Actuator_IB
    code-descriptors:
      code Code
        artifact-descriptors:
          short-label=autosar_tpc_actuator_c, category=SWSRC
          short-label=autosar_tpc_actuator_h, category=SWHDR
          short-label=autosar_tpc_actuator_private_h, category=SWHDR
          short-label=autosar_tpc_actuator_types_h, category=SWHDR
          short-label=rtwtypes_h, category=SWHDR
    resource consumption RsrcCons_autosar_tpc_actuator
