AUTOSAR XML (schema 4-3-1)
package /Timing
  vfb timing TPC_Composition_timing: component=TPC_Composition
    timing-requirements:
      execution order constraint EOC: base-composition=TPC_Composition
        ordered-elements:
          7 x eoc executable entity ref:
            PedalSensor_PedalSensor_Step: component=PedalSensor, executable=PedalSensor_Step, successor=TPS_Primary_ThrottleSensor1_Step
            TPS_Primary_ThrottleSensor1_Step: component=TPS_Primary, executable=ThrottleSensor1_Step, successor=TPS_Secondary_ThrottleSensor2_Step
            TPS_Secondary_ThrottleSensor2_Step: component=TPS_Secondary, executable=ThrottleSensor2_Step, successor=Monitor_ThrottleSensorMonitor_Step
            Monitor_ThrottleSensorMonitor_Step: component=Monitor, executable=ThrottleSensorMonitor_Step, successor=Ctrl_Controller_Step
            Ctrl_Controller_Step: component=Ctrl, executable=Controller_Step, successor=Actuator_Actuator_Step
            Actuator_Actuator_Step: component=Actuator, executable=Actuator_Step, successor=Ctrl2_ctrl2_1_Step
            Ctrl2_ctrl2_1_Step: component=Ctrl2, executable=ctrl2_1_Step
