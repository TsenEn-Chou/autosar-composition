AUTOSAR XML (schema 4-3-1)
package /TPC_Composition/Interfaces
  13 x sender receiver interface:
    ThrCmd_Percent
      data Value: category=VALUE, sw-calibration-access=READ-ONLY, type=Float
    ThrCmd_HwIO
      data Value: category=VALUE, sw-calibration-access=READ-ONLY, type=SInt16
    TPS_Percent
      data Value: category=VALUE, sw-calibration-access=READ-ONLY, type=float32
    APP_Percent
      data Value: category=VALUE, sw-calibration-access=READ-ONLY, type=Float
    InBus1
      data Value: category=VALUE, sw-calibration-access=READ-ONLY, display-format=%4.3f, type=Float
    InBus2
      data Value: category=VALUE, sw-calibration-access=READ-ONLY, type=Float
    OutBus
      data Value: category=VALUE, sw-calibration-access=READ-ONLY, type=UInt8
    TPS_Primary
      data Value: category=VALUE, sw-calibration-access=READ-ONLY, type=float32
    TPS_Seconday
      data Value: category=VALUE, sw-calibration-access=READ-ONLY, type=float32
    TPS_Secondary
      data Value: category=VALUE, sw-calibration-access=READ-ONLY, type=float32
    APP_HwIO
      data Value: category=VALUE, sw-calibration-access=READ-ONLY, type=UInt16
    TPS_HwIO
      data Value: category=VALUE, sw-calibration-access=READ-ONLY, type=uint16
    TPS_Secondary_Percent
      data Value: category=VALUE, sw-calibration-access=READ-ONLY, type=float32
