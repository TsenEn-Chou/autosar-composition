AUTOSAR XML (schema 4-3-1)
package /Components/SwcImplementations
  swc implementation ctrl2_1_Impl: programming-language=C, sw-version=2.18.1, used-code-generator=Embedded Coder 7.9 (R2022b) 13-May-2022, vendor-id=0, behavior=ctrl2_1_IB
    code-descriptors:
      code Code
        artifact-descriptors:
          short-label=ctrl2_1_c, category=SWSRC
          short-label=ctrl2_1_data_c, category=SWSRC
          short-label=ctrl2_1_h, category=SWHDR
          short-label=ctrl2_1_private_h, category=SWHDR
          short-label=ctrl2_1_types_h, category=SWHDR
          short-label=rtwtypes_h, category=SWHDR
    resource consumption RsrcCons_ctrl2_1
