AUTOSAR XML (schema 4-3-1)
standard types defined: Double, Float, UInt8, float64, float32, uint8
package /TPC_Composition/DataTypes
  4 x impl type:
    rt_Array_Double_12: category=ARRAY
      element rt_Array_Double_12: array-size=12, array-size-semantics=FIXED-SIZE, implementation-data-type=Double
    rt_Array_Double_4: category=ARRAY
      element rt_Array_Double_4: array-size=4, array-size-semantics=FIXED-SIZE, implementation-data-type=Double
    rt_Array_Double_3: category=ARRAY
      element rt_Array_Double_3: array-size=3, array-size-semantics=FIXED-SIZE, implementation-data-type=Double
    m_LkupTbl: category=STRUCTURE
      element BP2: implementation-data-type=rt_Array_Double_4
      element BP1: implementation-data-type=rt_Array_Double_3
      element Table: implementation-data-type=rt_Array_Double_12
package /TPC_Composition/DataTypes/ApplDataTypes
  app type Appl_my2d_LkupTbl:
    category=MAP
    sw-calibration-access=READ-WRITE
    sw-calprm-axis-set=[{sw-axis-index=1, category=STD_AXIS, sw-axis-individual={input-variable-type=Double, compu {identical}, sw-max-axis-points=4, sw-min-axis-points=4, range phys -INF..INF}}, {sw-axis-index=2, category=STD_AXIS, sw-axis-individual={input-variable-type=Double, compu {identical}, sw-max-axis-points=3, sw-min-axis-points=3, range phys -INF..INF}}]
    compu {identical}
    range phys -INF..INF
    sw-record-layout=IntMap_f64f64_f64_M
    value-axis-data-type=Double
  app type Double: category=VALUE, sw-calibration-access=READ-WRITE, compu {identical}, range phys -INF..INF
package /TPC_Composition/DataTypes/Constants
  constant specification L_4x6_single_ar: value-spec=[2 3 4 3 4 5 4 5 6 5 6 7] size 4x3 over axis [1 2 3 4] over axis [1 2 3]
package /TPC_Composition/DataTypes/DataTypeMappings
  data type mapping set ctrl2DataTypeMappingsSet
    data-type-maps:
      application-data-type=Double, implementation-data-type=Double
      application-data-type=Appl_my2d_LkupTbl, implementation-data-type=m_LkupTbl
package /TPC_Composition/DataTypes/SwAddrMethods
  sw addr method CODE: section-type=CODE
  sw addr method CONST: section-type=CONST
  sw addr method VAR: section-type=VAR
package /TPC_Composition/DataTypes/SwRecordLayouts
  sw record layout IntMap_f32f32_f64
  sw record layout IntMap_f64f64_f64_M: sw-record-layout-group={short-label=IntMap_f64f64_f64_M, sw-record-layout-group={short-label=X, category=INDEX_INCR, sw-record-layout-group-axis=1, sw-record-layout-group-index=X, sw-record-layout-group-from=1, sw-record-layout-group-to=-1, sw-record-layout-v={short-label=VALUE, base-type=float64, sw-record-layout-v-axis=1, sw-record-layout-v-prop=VALUE}}, sw-record-layout-group={short-label=Y, category=INDEX_INCR, sw-record-layout-group-axis=2, sw-record-layout-group-index=Y, sw-record-layout-group-from=1, sw-record-layout-group-to=-1, sw-record-layout-v={short-label=VALUE, base-type=float64, sw-record-layout-v-axis=2, sw-record-layout-v-prop=VALUE}}, sw-record-layout-group={short-label=Val, category=COLUMN_DIR, sw-record-layout-group-axis=1, sw-record-layout-group-index=X, sw-record-layout-group-from=1, sw-record-layout-group-to=-1, sw-record-layout-group={short-label=Val, sw-record-layout-group-axis=2, sw-record-layout-group-index=Y, sw-record-layout-group-from=1, sw-record-layout-group-to=-1, sw-record-layout-v={short-label=Val, base-type=float64, sw-record-layout-v-axis=0, sw-record-layout-v-prop=VALUE, sw-record-layout-v-index=X Y}}}}
package /TPC_Composition/DataTypes/Units
  unit NoUnit: factor-si-to-unit=1, offset-si-to-unit=0
