AUTOSAR XML (schema 4-3-1)
standard types defined: Double, Float, UInt32, UInt8, float64, float32, uint32, uint8
package /DataTypes
  4 x impl type:
    MyStruct: category=STRUCTURE
      5 x element, all with category=TYPE_REFERENCE:
        N2: implementation-data-type=UInt32
        N1: implementation-data-type=UInt32
        BP2: implementation-data-type=rt_Array_Float_4
        BP1: implementation-data-type=rt_Array_Float_3
        Table: implementation-data-type=rt_Array_Double_12
    rt_Array_Float_4: category=ARRAY
      element rt_Array_Float_4: array-size=4, array-size-semantics=FIXED-SIZE, implementation-data-type=Float
    rt_Array_Float_3: category=ARRAY
      element rt_Array_Float_3: array-size=3, array-size-semantics=FIXED-SIZE, implementation-data-type=Float
    rt_Array_Double_12: category=ARRAY
      element rt_Array_Double_12: array-size=12, array-size-semantics=FIXED-SIZE, implementation-data-type=Double
package /DataTypes/ApplDataTypes
  app type Appl_my2d_LkupTbl:
    category=MAP
    sw-calibration-access=READ-WRITE
    sw-calprm-axis-set=[{sw-axis-index=1, category=STD_AXIS, sw-axis-individual={input-variable-type=Float, compu {identical}, sw-max-axis-points=4, sw-min-axis-points=4, range phys -INF..INF}}, {sw-axis-index=2, category=STD_AXIS, sw-axis-individual={input-variable-type=Float, compu {identical}, sw-max-axis-points=3, sw-min-axis-points=3, range phys -INF..INF}}]
    compu {identical}
    range phys -INF..INF
    sw-record-layout=IntMap_f32f32_f64
    value-axis-data-type=Double
  app type Double: category=VALUE, sw-calibration-access=READ-WRITE, compu {identical}, range phys -INF..INF
  app type Float: category=VALUE, sw-calibration-access=READ-WRITE, compu {identical}, range phys -INF..INF
package /DataTypes/Constants
  constant specification my2d_LkupTbl: value-spec=[2 3 4 3 4 5 4 5 6 5 6 7] over axis [1 2 3 4] over axis [1 2 3]
package /DataTypes/DataTypeMappings
  data type mapping set ctrl2DataTypeMappingsSet
    data-type-maps:
      application-data-type=Double, implementation-data-type=Double
      application-data-type=Float, implementation-data-type=Float
      application-data-type=Appl_my2d_LkupTbl, implementation-data-type=MyStruct
package /DataTypes/SwAddrMethods
  sw addr method CODE: section-type=CODE
  sw addr method CONST: section-type=CONST
  sw addr method VAR: section-type=VAR
package /DataTypes/SwRecordLayouts
  sw record layout IntMap_f32f32_f64: sw-record-layout-group={short-label=IntMap_f32f32_f64, sw-record-layout-v={short-label=Nx, base-type=uint32, sw-record-layout-v-axis=1, sw-record-layout-v-prop=COUNT}, sw-record-layout-v={short-label=Ny, base-type=uint32, sw-record-layout-v-axis=2, sw-record-layout-v-prop=COUNT}, sw-record-layout-group={short-label=X, category=INDEX_INCR, sw-record-layout-group-axis=1, sw-record-layout-group-index=X, sw-record-layout-group-from=1, sw-record-layout-group-to=-1, sw-record-layout-v={short-label=VALUE, base-type=float64, sw-record-layout-v-axis=1, sw-record-layout-v-prop=VALUE}}, sw-record-layout-group={short-label=Y, category=INDEX_INCR, sw-record-layout-group-axis=2, sw-record-layout-group-index=Y, sw-record-layout-group-from=1, sw-record-layout-group-to=-1, sw-record-layout-v={short-label=VALUE, base-type=float64, sw-record-layout-v-axis=2, sw-record-layout-v-prop=VALUE}}, sw-record-layout-group={short-label=Val, category=COLUMN_DIR, sw-record-layout-group-axis=1, sw-record-layout-group-index=X, sw-record-layout-group-from=1, sw-record-layout-group-to=-1, sw-record-layout-group={short-label=Val, sw-record-layout-group-axis=2, sw-record-layout-group-index=Y, sw-record-layout-group-from=1, sw-record-layout-group-to=-1, sw-record-layout-v={short-label=Val, base-type=float64, sw-record-layout-v-axis=0, sw-record-layout-v-prop=VALUE, sw-record-layout-v-index=X Y}}}}
package /DataTypes/Units
  unit NoUnit: factor-si-to-unit=1, offset-si-to-unit=0
