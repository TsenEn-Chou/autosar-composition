AUTOSAR XML (schema 4-3-1)
package /TPC_Composition/Interfaces
  sender receiver interface InBus1
    data Value: category=VALUE, sw-calibration-access=READ-ONLY, display-format=%4.3f, type=Float
  sender receiver interface InBus2
    data Value: category=VALUE, sw-calibration-access=READ-ONLY, type=Float
  sender receiver interface OutBus
    data Value: category=VALUE, sw-calibration-access=READ-ONLY, type=UInt8
