AUTOSAR XML (schema 4-3-1)
package /TPC_Composition/Interfaces
  4 x sender receiver interface:
    TPS_HwIO
      data Value: category=VALUE, sw-calibration-access=READ-ONLY, type=uint16
    TPS_Percent
      data Value: category=VALUE, sw-calibration-access=READ-ONLY, type=float32
    TPS_Secondary_Percent
      data Value: category=VALUE, sw-calibration-access=READ-ONLY, type=float32
    TPS_Secondary
      data Value: category=VALUE, sw-calibration-access=READ-ONLY, type=float32
