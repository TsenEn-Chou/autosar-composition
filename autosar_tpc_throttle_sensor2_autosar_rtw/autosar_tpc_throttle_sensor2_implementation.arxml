AUTOSAR XML (schema 4-3-1)
package /Components/SwcImplementations
  swc implementation ThrottleSensor2_Impl: programming-language=C, sw-version=4.1.1, used-code-generator=Embedded Coder 7.8 (R2022a) 23-Nov-2021, vendor-id=0, behavior=ThrottleSensor2_IB
    code-descriptors:
      code Code
        artifact-descriptors:
          short-label=autosar_tpc_throttle_sensor2_c, category=SWSRC
          short-label=look1_iflf_linlcpw_c, category=SWSRC
          short-label=autosar_tpc_throttle_sensor2_h, category=SWHDR
          short-label=autosar_tpc_throttle_sensor2_private_h, category=SWHDR
          short-label=autosar_tpc_throttle_sensor2_types_h, category=SWHDR
          short-label=look1_iflf_linlcpw_h, category=SWHDR
          short-label=rtwtypes_h, category=SWHDR
    resource consumption RsrcCons_autosar_tpc_throttle_sensor2
