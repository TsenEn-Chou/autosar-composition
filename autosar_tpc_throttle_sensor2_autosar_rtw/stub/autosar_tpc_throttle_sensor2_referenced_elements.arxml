AUTOSAR XML (schema 4-3-1)
standard types defined: boolean, uint8, uint16, uint32, sint8, sint16, sint32, float32, float64, void
package /AUTOSAR
  compu method DefaultBooleanCompuMethod: 0=false, 1=true
  unit NoUnit: factor-si-to-unit=1, offset-si-to-unit=0
  app type UInt4: category=VALUE, sw-calibration-access=READ-WRITE, range phys 0..15
  app type SInt4: category=VALUE, sw-calibration-access=READ-WRITE, range phys -8..7
  app type UInt8: category=VALUE, sw-calibration-access=READ-WRITE, range phys 0..255
  app type SInt8: category=VALUE, sw-calibration-access=READ-WRITE, range phys -128..127
  app type UInt16: category=VALUE, sw-calibration-access=READ-WRITE, range phys 0..65535
  app type SInt16: category=VALUE, sw-calibration-access=READ-WRITE, range phys -32768..32767
  app type UInt32: category=VALUE, sw-calibration-access=READ-WRITE, range phys 0..4294967295
  app type SInt32: category=VALUE, sw-calibration-access=READ-WRITE, range phys -2147483648..2147483647
  app type Float_with_NaN: category=VALUE, sw-calibration-access=READ-WRITE, range phys -INF..INF
  app type Float: category=VALUE, sw-calibration-access=READ-WRITE, compu-method=Identcl, range phys -INF..INF
  app type Double_with_NaN: category=VALUE, sw-calibration-access=READ-WRITE, range phys -INF..INF
  app type Double: category=VALUE, sw-calibration-access=READ-WRITE, range phys -INF..INF
  app type Boolean: category=BOOLEAN, sw-calibration-access=READ-WRITE  # Boolean has the value space required to support the mathematical concept of binary-valued logic: {TRUE, FALSE}.
package /AUTOSAR/Services/Dem
  impl type Dem_EventStatusType: category=VALUE, base-type=uint8, compu {0=DEM_EVENT_STATUS_PASSED, 1=DEM_EVENT_STATUS_FAILED, 2=DEM_EVENT_STATUS_PREPASSED, 3=DEM_EVENT_STATUS_PREFAILED}
  impl type Dem_EventStatusExtendedType: category=VALUE, base-type=uint8, compu {1=DEM_UDS_STATUS_TF, 2=DEM_UDS_STATUS_TFTOC, 4=DEM_UDS_STATUS_PDTC, 8=DEM_UDS_STATUS_CDTC, 16=DEM_UDS_STATUS_TNCSLC, 32=DEM_UDS_STATUS_TFSLC, 64=DEM_UDS_STATUS_TNCTOC, 128=DEM_UDS_STATUS_WIR}
  impl type Dem_DTCFormatType: category=VALUE, base-type=uint8, compu {0=DEM_DTC_FORMAT_OBD, 1=DEM_DTC_FORMAT_UDS}
  impl type Dem_IumprDenomCondStatusType: category=VALUE, base-type=uint8, compu {0=DEM_IUMPR_DEN_STATUS_NOT_REACHED, 1=DEM_IUMPR_DEN_STATUS_REACHED, 2=DEM_IUMPR_DEN_STATUS_INHIBITED}
  impl type Dem_DTRControlType: category=VALUE, base-type=uint8, compu {0=DEM_DTR_CTL_NORMAL, 1=DEM_DTR_CTL_NO_MAX, 2=DEM_DTR_CTL_NO_MIN, 3=DEM_DTR_CTL_RESET, 4=DEM_DTR_CTL_INVISIBLE}
  impl type Dem_IndicatorStatusType: category=VALUE, base-type=uint8, compu {0=DEM_INDICATOR_OFF, 1=DEM_INDICATOR_CONTINUOUS, 2=DEM_INDICATOR_BLINKING, 3=DEM_INDICATOR_BLINK_CONT, 4=DEM_INDICATOR_SLOW_FLASH, 5=DEM_INDICATOR_FAST_FLASH, 6=DEM_INDICATOR_ON_DEMAND, 7=DEM_INDICATOR_SHORT}
  impl type Dem_OperationCycleStateType: category=VALUE, base-type=uint8, compu {0=DEM_CYCLE_STATE_START, 1=DEM_CYCLE_STATE_END}
  client server interface DiagnosticMonitor: is-service=true
    5 x operation, all with possible-error=DiagnosticMonitor/E_NOT_OK:
      SetEventStatus
        arg EventStatus: category=VALUE, sw-calibration-access=READ-ONLY, type=Dem_EventStatusType, direction=IN
      ResetEventStatus
      PrestoreFreezeFrame
      ClearPrestoredFreezeFrame
      SetEventDisabled
    error E_NOT_OK: error-code=1
  client server interface CallbackEventStatusChange: is-service=true
    operation EventStatusChanged: possible-error=CallbackEventStatusChange/E_NOT_OK
      arg EventStatusOld: category=VALUE, sw-calibration-access=READ-ONLY, type=Dem_EventStatusExtendedType, direction=IN
      arg EventStatusNew: category=VALUE, sw-calibration-access=READ-ONLY, type=Dem_EventStatusExtendedType, direction=IN
    error E_NOT_OK: error-code=1
  client server interface DiagnosticInfo: is-service=true
    7 x operation:
      GetEventStatus: possible-error=DiagnosticInfo/E_NOT_OK
        arg EventStatusExtended: category=VALUE, sw-calibration-access=READ-ONLY, type=Dem_EventStatusExtendedType, direction=OUT
      GetEventFailed: possible-error=DiagnosticInfo/E_NOT_OK
        arg EventFailed: category=VALUE, sw-calibration-access=READ-ONLY, type=boolean, direction=OUT
      GetEventTested: possible-error=DiagnosticInfo/E_NOT_OK
        arg EventTested: category=VALUE, sw-calibration-access=READ-ONLY, type=boolean, direction=OUT
      GetDTCOfEvent: possible-error=[DiagnosticInfo/E_NOT_OK, DEM_E_NO_DTC_AVAILABLE]
        arg DTCFormat: category=VALUE, sw-calibration-access=READ-ONLY, type=Dem_DTCFormatType, direction=IN
        arg DTCOfEvent: category=VALUE, sw-calibration-access=READ-ONLY, type=uint32, direction=OUT
      GetFaultDetectionCounter: possible-error=DiagnosticInfo/E_NOT_OK
        arg FaultDetectionCounter: category=VALUE, sw-calibration-access=READ-ONLY, type=sint8, direction=OUT
      GetEventExtendedDataRecord: possible-error=DiagnosticInfo/E_NOT_OK
        arg RecordNumber: category=VALUE, sw-calibration-access=READ-ONLY, type=uint8, direction=IN
        arg DestBuffer: category=ARRAY, sw-calibration-access=READ-ONLY, type=Dem_MaxDataValueType, direction=OUT
      GetEventFreezeFrameData: possible-error=DiagnosticInfo/E_NOT_OK
        4 x arg, all with sw-calibration-access=READ-ONLY:
          RecordNumber: category=VALUE, type=uint8, direction=IN
          ReportTotalRecord: category=VALUE, type=boolean, direction=IN
          DataId: category=VALUE, type=uint16, direction=IN
          DestBuffer: category=ARRAY, type=Dem_MaxDataValueType, direction=OUT
    error E_NOT_OK: error-code=1
    error DEM_E_NO_DTC_AVAILABLE: error-code=2
  impl type Dem_MaxDataValueType: category=ARRAY
    element Dem_MaxDataValueType: array-size=4, array-size-semantics=FIXED-SIZE, implementation-data-type=uint8
  10 x client server interface, all with is-service=true:
    PfcCycleQualified
      operation SetPfcCycleQualified: possible-error=PfcCycleQualified/E_NOT_OK
      operation GetPfcCycleQualified: possible-error=PfcCycleQualified/E_NOT_OK
      error E_NOT_OK: error-code=1
    IUMPRDenominatorCondition
      operation SetIUMPRDenCondition: possible-error=IUMPRDenominatorCondition/E_NOT_OK
        arg ConditionStatus: category=VALUE, sw-calibration-access=READ-ONLY, type=Dem_IumprDenomCondStatusType, direction=IN
      operation GetIUMPRDenCondition: possible-error=IUMPRDenominatorCondition/E_NOT_OK
        arg ConditionStatus: category=VALUE, sw-calibration-access=READ-ONLY, type=Dem_IumprDenomCondStatusType, direction=OUT
      error E_NOT_OK: error-code=1
    IUMPRNumerator
      operation RepIUMPRFaultDetect: possible-error=IUMPRNumerator/E_NOT_OK
      error E_NOT_OK: error-code=1
    IUMPRDenominator
      operation RepIUMPRDenLock: possible-error=IUMPRDenominator/E_NOT_OK
      operation RepIUMPRDenRelease: possible-error=IUMPRDenominator/E_NOT_OK
      error E_NOT_OK: error-code=1
    DTRCentralReport
      operation SetDTR: possible-error=DTRCentralReport/E_NOT_OK
        4 x arg, all with category=VALUE, sw-calibration-access=READ-ONLY, direction=IN:
          DTRId: type=uint16
          TestResult: type=sint32
          LowerLimit: type=sint32
          Ctrlval: type=Dem_DTRControlType
      error E_NOT_OK: error-code=1
    EventAvailable
      operation SetEventAvailable: possible-error=EventAvailable/E_NOT_OK
        arg AvailableStatus: category=VALUE, sw-calibration-access=READ-ONLY, type=boolean, direction=IN
      error E_NOT_OK: error-code=1
    IndicatorStatus
      operation GetIndicatorStatus: possible-error=IndicatorStatus/E_NOT_OK
        arg IndicatorStatus: category=VALUE, sw-calibration-access=READ-ONLY, type=Dem_IndicatorStatusType, direction=OUT
      error E_NOT_OK: error-code=1
    EnableCondition
      operation SetEnableCondition: possible-error=EnableCondition/E_NOT_OK
        arg ConditionFulfilled: category=VALUE, sw-calibration-access=READ-ONLY, type=boolean, direction=IN
      error E_NOT_OK: error-code=1
    StorageCondition
      operation SetStorageCondition: possible-error=StorageCondition/E_NOT_OK
        arg ConditionFulfilled: category=VALUE, sw-calibration-access=READ-ONLY, type=boolean, direction=IN
      error E_NOT_OK: error-code=1
    OperationCycle
      operation SetOperationCycleState: possible-error=OperationCycle/E_NOT_OK
        arg CycleState: category=VALUE, sw-calibration-access=READ-ONLY, type=Dem_OperationCycleStateType, direction=IN
      operation GetOperationCycleState: possible-error=OperationCycle/E_NOT_OK
        arg CycleState: category=VALUE, sw-calibration-access=READ-ONLY, type=Dem_OperationCycleStateType, direction=OUT
      error E_NOT_OK: error-code=1
package /AUTOSAR/Services/NvM
  impl type NvM_RequestResultType: implementation-data-type=uint8
  client server interface NvMService: is-service=true  # Covers AUTOSAR_SWS_NVRAMManager.pdf V3.2.0 R4.0 Rev 3 - NVM734
    9 x operation, all with possible-error=NvMService/E_NOT_OK:
      GetDataIndex
        arg DataIndexPtr: category=VALUE, sw-calibration-access=READ-ONLY, type=uint8, direction=OUT
      SetDataIndex
        arg DataIndex: category=VALUE, sw-calibration-access=READ-ONLY, type=uint8, direction=IN
      SetRamBlockStatus
        arg BlockChanged: category=VALUE, sw-calibration-access=READ-ONLY, type=boolean, direction=IN
      ReadBlock
        arg DstPtr: category=DATA_REFERENCE, sw-calibration-access=READ-ONLY, type=NvM_DstPtrType, direction=IN
      WriteBlock
        arg SrcPtr: category=DATA_REFERENCE, sw-calibration-access=READ-ONLY, type=NvM_DstPtrType, direction=IN
      RestoreBlockDefaults
        arg DestPtr: category=DATA_REFERENCE, sw-calibration-access=READ-ONLY, type=NvM_DstPtrType, direction=IN
      EraseNvBlock
      InvalidateNvBlock
      GetErrorStatus
        arg RequestResultPtr: category=TYPE_REFERENCE, sw-calibration-access=READ-ONLY, type=NvM_RequestResultType, direction=OUT
    error E_NOT_OK: error-code=1
  impl type NvM_DstPtrType: category=DATA_REFERENCE, sw-pointer-target-props={target-category=VALUE, base-type=void}
  client server interface NvMAdmin: is-service=true
    operation SetBlockProtection: possible-error=NvMAdmin/E_NOT_OK
      arg ProtectionEnabled: category=VALUE, sw-calibration-access=READ-ONLY, type=boolean, direction=IN
    error E_NOT_OK: error-code=1
