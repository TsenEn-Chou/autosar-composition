AUTOSAR XML (schema 4-3-1)
package /TPC_Composition/Interfaces
  sender receiver interface TPS_HwIO
    data Value: category=VALUE, sw-calibration-access=READ-ONLY, type=uint16
  sender receiver interface TPS_Percent
    data Value: category=VALUE, sw-calibration-access=READ-ONLY, type=float32
  sender receiver interface TPS_Primary
    data Value: category=VALUE, sw-calibration-access=READ-ONLY, type=float32
